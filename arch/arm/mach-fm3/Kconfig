## arch/arm/mach-fm3/Kconfig
```kconfig
if ARCH_FM3

config MACH_FRK_FM3
	bool
	default y
	select ARM_NVIC
	help
	  CQ publishing FRK-FM3 board

endif
```

## arch/rx/Kconfig
```kconfig
#
# For a description of the syntax of this configuration file,
# see Documentation/kbuild/kconfig-language.txt.
#

config RX
        def_bool y
       	select EMBEDDED
	select HAVE_CLK
	select HAVE_SYSCALL_TRACEPOINTS
	
config MMU
	def_bool n

config SWAP
	def_bool n

config ZONE_DMA
	def_bool n

config FPU
	def_bool n

config RWSEM_GENERIC_SPINLOCK
	def_bool y

config RWSEM_XCHGADD_ALGORITHM
	def_bool n

config ARCH_HAS_ILOG2_U32
	def_bool n

config ARCH_HAS_ILOG2_U64
	def_bool n

config GENERIC_FIND_NEXT_BIT
	def_bool y

config GENERIC_HWEIGHT
	def_bool y

config GENERIC_HARDIRQS
	def_bool y

config GENERIC_CALIBRATE_DELAY
	def_bool y

config GENERIC_TIME
	def_bool y

config GENERIC_BUG
        bool
        depends on BUG

config TIME_LOW_RES
	def_bool y

config NO_IOPORT
	def_bool y

config NO_DMA
	def_bool y

config ISA
       def_bool n

config PCI
	bool
	default n

config HZ
	int
	default 100

source "init/Kconfig"

source "kernel/Kconfig.freezer"

menu "Processor type and features"

source "kernel/time/Kconfig"

choice
	prompt "Platform"
	default RX_GDB_SIM

config RX_GDB_SIM
	bool "GDB Simulator"
	select CPU_RX610
	help
	  GDB Simulator
endchoice

config CPU_RX610
       bool
       select RX_IPR

config RX_IPR
       bool

config INPUT_CLOCK_FREQ
       int "Input clock frequency"

config PCLK_MULT
       int "Peripheral clock multiple rate"

choice
	prompt "Kernel executes from"
	---help---
	  Choose the memory type that the kernel will be running in.

config RAMKERNEL
	bool "RAM"
	help
	  The kernel will be resident in RAM when running.

config ROMKERNEL
	bool "ROM"
	help
	  The kernel will be resident in FLASH/ROM when running.
endchoice

menu "memory map"
config ROMSTART
       depends on ROMKERNEL
       hex "ROM start address"
config ROMEND
       depends on ROMKERNEL
       hex "ROM end address"
config RAMSTART
       hex "RAM start address"
config RAMEND
       hex "RAM end address"
config INITIAL_STACK
       hex "Initial stack address"
endmenu

choice
	prompt "Timer"
config RX_CMT
	bool "CMT"
endchoice

config RX_CMT_CH
       int "Channel"
       depends on RX_CMT
       help 
         unit0-channel0 = 0
         unit0-channel1 = 1
         unit1-channel0 = 2
         unit1-channel1 = 3

config PREEMPT
	bool "Preemptible Kernel"
	default n

source "mm/Kconfig"

endmenu

menu "Executable file formats"

source "fs/Kconfig.binfmt"

endmenu

source "net/Kconfig"

source "drivers/Kconfig"

source "fs/Kconfig"

source "arch/rx/Kconfig.debug"

source "security/Kconfig"

source "crypto/Kconfig"

source "lib/Kconfig"
```
